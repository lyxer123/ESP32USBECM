## main/Kconfig.projbuild
```kconfig
menu "Example Configuration"

    choice EXAMPLE_NETWORK_TOPOLOGY
        prompt "USB ECM network topology"
        default EXAMPLE_TOPO_ECM_ROUTER_WIFI_AP
        help
            Choose data path. Original: upstream DHCP on USB ECM (router/PC), share via Wi‑Fi AP + NAPT.
            Reverse: join Wi‑Fi as STA, give the PC on CH397 RJ45 a private subnet via DHCP + NAPT to Wi‑Fi.

        config EXAMPLE_TOPO_ECM_ROUTER_WIFI_AP
            bool "Router/PC — [CH397 ECM] — ESP32 — Wi‑Fi AP (NAT to ECM)"

        config EXAMPLE_TOPO_WIFI_STA_ECM_PC
            bool "Wi‑Fi STA — ESP32 — [CH397 ECM] — PC Ethernet (NAT to Wi‑Fi)"
            select LWIP_IP_FORWARD
            select LWIP_IPV4_NAPT
    endchoice

    config EXAMPLE_ECM_DOWNSTREAM_GATEWAY_IP
        string "ECM LAN IP (gateway for PC on RJ45)"
        depends on EXAMPLE_TOPO_WIFI_STA_ECM_PC
        default "192.168.137.1"
        help
            Static IPv4 on the USB ECM interface toward the PC. PC uses DHCP from the ESP; this address is the PC default gateway.

    config EXAMPLE_ECM_DOWNSTREAM_NETMASK
        string "ECM LAN netmask"
        depends on EXAMPLE_TOPO_WIFI_STA_ECM_PC
        default "255.255.255.0"

    config ESP_IDF_VERSION
       string
       option env="ESP_IDF_VERSION"

    config EXAMPLE_USB_ECM_IPERF
        bool "Enable USB ECM Iperf"
        help
            Enable USB ECM Iperf test, which is used to test the performance of USB ECM module.

    config EXAMPLE_USB_ECM_DOWNLOAD_SPEED_TEST
        bool "Enable USB ECM Download Speed Test"
        default n
        help
            Enable USB ECM Download Speed Test, which is used to test the download speed of USB ECM module.

    config EXAMPLE_USB_ECM_LIGHT_SLEEP_TEST
        bool "Enable USB ECM Light Sleep Test"
        default n
        select EXAMPLE_ENABLE_AT_CMD
        help
            Enable USB ECM Light Sleep Test, which is used to test USB ECM module in light sleep mode.

    config EXAMPLE_MODULE_RST_GPIO_NUM
        depends on EXAMPLE_USB_ECM_LIGHT_SLEEP_TEST
        int "USB ECM Module RST GPIO Number"
        default 5
        help
            Set the USB ECM module RST GPIO number.

    config EXAMPLE_MODULE_WAKEUP_GPIO_NUM
        depends on EXAMPLE_USB_ECM_LIGHT_SLEEP_TEST
        int "USB ECM Module WAKEUP GPIO Number"
        default 3
        help
            Set the USB ECM module WAKEUP GPIO number.

    config EXAMPLE_MODULE_WAKEUP_LEVEL
        depends on EXAMPLE_USB_ECM_LIGHT_SLEEP_TEST
        int "USB ECM Module WAKEUP Level"
        default 0
        range 0 1
        help
            Set the USB ECM module WAKEUP level.

    config EXAMPLE_ENABLE_AT_CMD
        bool "Enable USB ECM AT Command"
        default n
        help
            Enable USB ECM AT Command.

    config EXAMPLE_AT_INTERFACE_NUM
        depends on EXAMPLE_ENABLE_AT_CMD
        int "USB ECM AT Interface Number"
        default 2
        help
            Set the USB ECM AT interface number.

    config EXAMPLE_USE_USB_HOST_FULLSPEED
        bool "Use USB Host Full Speed"
        depends on IDF_TARGET_ESP32P4 && ESP_IDF_VERSION >= 5.5
        default n
        help
            By default, USB Host High Speed is used. Enable this option to use USB Host Full Speed instead.
endmenu
```
